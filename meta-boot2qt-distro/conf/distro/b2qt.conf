## meta-boot2qt-distro/conf/distro/b2qt.conf
```bitbake
# Copyright (C) 2024 The Qt Company Ltd.
# SPDX-License-Identifier: LicenseRef-Qt-Commercial OR GPL-3.0-only

include conf/distro/poky.conf

DISTRO = "b2qt"
DISTRO_NAME = "Boot to Qt for Embedded Linux"
SDK_VERSION := "${DISTRO_VERSION}"

BUILDCFG_VARS += "SDKMACHINE QT_VERSION"

MACHINE_HOSTNAME ?= "b2qt-${MACHINE}"

MAINTAINER = "B2Qt <b2qt@qt.io>"

SYSVINIT_ENABLED_GETTYS = ""

POKY_DEFAULT_DISTRO_FEATURES:remove = "ptest"
DISTRO_FEATURES_DEFAULT:remove = "irda pcmcia pci 3g nfc zeroconf x11"
DISTRO_FEATURES_BACKFILL_CONSIDERED = "sysvinit"

DISTRO_FEATURES_FILTER_NATIVESDK:append = " wayland"

FONTCONFIG_CACHE_DIR = "${libdir}/fontconfig/cache"

DISTRO_FEATURES += "gstreamer webengine systemd pam virtualization minidebuginfo"
DISTRO_FEATURES:remove:mipsarch = "webengine virtualization"
DISTRO_FEATURES:remove:riscv64 = "webengine virtualization"

INIT_MANAGER = "systemd"

PREFERRED_PROVIDER_jpeg ?= "libjpeg-turbo"
PREFERRED_PROVIDER_jpeg-native ?= "libjpeg-turbo-native"

IMAGE_FSTYPES += "conf"
IMAGE_CLASSES += "deploy-conf"

QBSP_README ?= "README"
QBSP_IMAGE_CONTENT ?= "${QBSP_README}"
QBSP_IMAGE_DEPENDS ?= "qbsp-readme:do_deploy"

LICENSE_CREATE_PACKAGE = "1"
COPY_LIC_MANIFEST = "1"

CLANG_EXTRA_OE_VENDORS = "${TARGET_VENDOR} -pokysdk"

QT_EDITION = "commercial"

USE_SQUISH ?= "${@bb.utils.contains('QT_INTERNAL_BUILD', '1', \
    bb.utils.vercmp_string_op(d.getVar('QT_VERSION'), '6.6', '>') & \
    bb.utils.vercmp_string_op(d.getVar('QT_VERSION'), '6.9', '<'), False, d)}"
USE_SQUISH:mipsarch ?= "0"

include conf/distro/include/b2qt.inc
include conf/distro/include/machine-settings.inc
include conf/distro/include/preferred-providers-${SDK_OS}.inc

inherit core-image-selinux
```

## meta-boot2qt-distro/conf/distro/include/fsl.inc
```bitbake
# Copyright (C) 2024 The Qt Company Ltd.
# SPDX-License-Identifier: LicenseRef-Qt-Commercial OR GPL-3.0-only

include conf/distro/include/imx.inc

DEPLOY_CONF_NAME:imx6qdlsabresd = "NXP i.MX6QP/Q/DL SABRE Smart Device"
DEPLOY_CONF_NAME:imx7dsabresd = "NXP SABRE SD i.MX7 Dual"
DEPLOY_CONF_NAME:imx8mm-ddr4-evk = "NXP i.MX 8M Mini DDR4 EVK"
DEPLOY_CONF_NAME:imx8mm-lpddr4-evk = "NXP i.MX 8M Mini LPDDR4 EVK"
DEPLOY_CONF_NAME:imx8mn-ddr4-evk = "NXP i.MX 8M Nano DDR4 EVK"
DEPLOY_CONF_NAME:imx8mn-lpddr4-evk = "NXP i.MX 8M Nano LPDDR4 EVK"
DEPLOY_CONF_NAME:imx8mp-ddr4-evk = "NXP i.MX 8M Plus DDR4 EVK"
DEPLOY_CONF_NAME:imx8mp-lpddr4-evk = "NXP i.MX 8M Plus LPDDR4 EVK"
DEPLOY_CONF_NAME:imx8mq-evk = "NXP i.MX 8MQuad EVK"
DEPLOY_CONF_NAME:imx8qm-mek = "NXP i.MX 8QuadMax MEK"
DEPLOY_CONF_NAME:imx8qxp-mek = "NXP i.MX 8QuadXPlus MEK"
DEPLOY_CONF_NAME:imx8ulp-lpddr4-evk = "NXP i.MX 8 ULP EVK"
DEPLOY_CONF_NAME:imx93-11x11-lpddr4x-evk = "NXP i.MX 93 11x11 LPDDR4X EVK"

# Use NXP BSP and u-boot for default (meta-freescale-distro)
IMX_DEFAULT_BSP = "nxp"
IMX_DEFAULT_BOOTLOADER:imx-nxp-bsp = "u-boot-imx"
IMX_DEFAULT_KERNEL:imx-nxp-bsp = "linux-imx"
```

## meta-boot2qt-distro/conf/distro/include/imx.inc
```bitbake
# Copyright (C) 2024 The Qt Company Ltd.
# SPDX-License-Identifier: LicenseRef-Qt-Commercial OR GPL-3.0-only

IMAGE_FSTYPES += "wic.xz"

DEPLOY_CONF_IMAGE_TYPE = "wic.xz"

QBSP_IMAGE_CONTENT += "\
    ${IMAGE_LINK_NAME}.${DEPLOY_CONF_IMAGE_TYPE} \
    ${IMAGE_LINK_NAME}.conf \
    ${IMAGE_LINK_NAME}.info \
    ${IMAGE_LINK_NAME}.spdx.tar.zst \
"

QBSP_LICENSE_FILE ?= "${FSL_EULA_FILE}"
QBSP_LICENSE_NAME ?= "NXP Semiconductors Software License Agreement"

GPULESS_FEATURES = "wayland opengl vulkan webengine virtualization"
DISTRO_FEATURES:remove:mx6ul-generic-bsp = "${GPULESS_FEATURES}"
DISTRO_FEATURES:remove:mx7-generic-bsp = "${GPULESS_FEATURES}"
DISTRO_FEATURES:remove:mx93-generic-bsp = "${GPULESS_FEATURES}"

BBMASK += "meta-freescale/dynamic-layers/qt6-layer/recipes-qt/qt6"
```

## meta-boot2qt-distro/conf/distro/include/intel.inc
```bitbake
# Copyright (C) 2024 The Qt Company Ltd.
# SPDX-License-Identifier: LicenseRef-Qt-Commercial OR GPL-3.0-only

DEPLOY_CONF_NAME = "Intel NUC"

IMAGE_FSTYPES += "wic.xz"

DISTRO_FEATURES:remove = "usbgadget"

DEPLOY_CONF_IMAGE_TYPE = "wic.xz"

QBSP_IMAGE_CONTENT += "\
    ${IMAGE_LINK_NAME}.${DEPLOY_CONF_IMAGE_TYPE} \
    ${IMAGE_LINK_NAME}.conf \
    ${IMAGE_LINK_NAME}.info \
    "

INITRAMFS_IMAGE = "core-image-minimal-initramfs"

SYSVINIT_ENABLED_GETTYS = "1"

SERIAL_CONSOLES += "115200;ttyUSB0"

WKS_FILE = "systemd-bootdisk-microcode-initramfs.wks"
WKS_FILE_DEPENDS:append = " microcode-initramfs"
```

## meta-boot2qt-distro/conf/distro/include/machine-settings.inc
```bitbake
# Copyright (C) 2024 The Qt Company Ltd.
# SPDX-License-Identifier: LicenseRef-Qt-Commercial OR GPL-3.0-only

MACHINE_FAMILY ??= "empty"
MACHINE_FAMILY:intel-x86-common = "intel"
MACHINE_FAMILY:qemuall = "qemu"
MACHINE_FAMILY:rpi = "raspberrypi"
MACHINE_FAMILY:tegra = "jetson"

include conf/distro/include/${MACHINE_FAMILY}.inc
include conf/distro/include/${MACHINE}.inc

# prefer .inc, but include .conf for backwards compatibility
include conf/distro/include/${MACHINE}.conf
```

## meta-boot2qt-distro/conf/distro/include/no-gpl3.inc
```bitbake
# Copyright (C) 2024 The Qt Company Ltd.
# SPDX-License-Identifier: LicenseRef-Qt-Commercial OR GPL-3.0-only

# Configuration for boot2qt image without (L)GPLv3 components
# Include in your conf/local.conf and add meta-gplv2 layer to your configuration
# https://www.yoctoproject.org/docs/latest/mega-manual/mega-manual.html#migration-2.3-gplv2-and-gplv3-moves

INCOMPATIBLE_LICENSE += "*GPLv3"

IMAGE_FEATURES:remove:pn-b2qt-embedded-qt6-image = "tools-debug debug-tweaks"

RDEPENDS:packagegroup-b2qt-embedded-tools:remove:pn-packagegroup-b2qt-embedded-tools = "binutils binutils-symlinks perf"
RDEPENDS:packagegroup-b2qt-embedded-base:remove:pn-packagegroup-b2qt-embedded-base = "ttf-freefont-mono"

PACKAGECONFIG:remove:pn-qtvirtualkeyboard = "hunspell"
PACKAGECONFIG:remove:pn-python3-pygobject = "cairo"

# intel nuc specific changes
IMAGE_FSTYPES:intel-x86-common = "tar.gz"
MACHINE_EXTRA_INSTALL:remove:intel-x86-common = "grub-efi-config"
QBSP_IMAGE_CONTENT:intel-x86-common = ""
```

## meta-boot2qt-distro/conf/distro/include/preferred-providers-mingw32.inc
```bitbake
PREFERRED_PROVIDER_nativesdk-python3 ?= "nativesdk-prebuild-python"
PREFERRED_PROVIDER_nativesdk-python3-qface ?= "nativesdk-prebuild-python"
PREFERRED_PROVIDER_nativesdk-python3-click = "nativesdk-prebuild-python"
PREFERRED_PROVIDER_nativesdk-python3-pytest = "nativesdk-prebuild-python"
PREFERRED_PROVIDER_nativesdk-python3-six = "nativesdk-prebuild-python"
PREFERRED_PROVIDER_nativesdk-python3-jinja2 = "nativesdk-prebuild-python"
PREFERRED_PROVIDER_nativesdk-python3-markupsafe = "nativesdk-prebuild-python"
PREFERRED_PROVIDER_nativesdk-python3-watchdog = "nativesdk-prebuild-python"
PREFERRED_PROVIDER_nativesdk-python3-pyyaml = "nativesdk-prebuild-python"
PREFERRED_PROVIDER_nativesdk-python3-coloredlogs = "nativesdk-prebuild-python"
PREFERRED_PROVIDER_nativesdk-python3-colorama = "nativesdk-prebuild-python"
PREFERRED_PROVIDER_nativesdk-python3-html5lib = "nativesdk-prebuild-python"
```

## meta-boot2qt-distro/conf/distro/include/qemu.inc
```bitbake
# Copyright (C) 2024 The Qt Company Ltd.
# SPDX-License-Identifier: LicenseRef-Qt-Commercial OR GPL-3.0-only

MACHINE_EXTRA_INSTALL_SDK += "libnss-mdns"
```

## meta-boot2qt-distro/conf/layer.conf
```bitbake
# Copyright (C) 2024 The Qt Company Ltd.
# SPDX-License-Identifier: LicenseRef-Qt-Commercial OR GPL-3.0-only

# We have a conf and classes directory, append to BBPATH
BBPATH .= ":${LAYERDIR}"

# We have a recipes directory, add to BBFILES
BBFILES += "${LAYERDIR}/recipes*/*/*.bb \
            ${LAYERDIR}/recipes*/*/*.bbappend \
            "

BBFILE_COLLECTIONS += "b2qt-distro"
BBFILE_PATTERN_b2qt-distro := "^${LAYERDIR}/"
BBFILE_PRIORITY_b2qt-distro = "20"

LAYERSERIES_COMPAT_b2qt-distro = "scarthgap"

# recipe appends for machine specific BSP layers
BBFILES_DYNAMIC += " \
    freescale-layer:${LAYERDIR}/dynamic-layers/freescale-layer/recipes*/*/*.bb \
    freescale-layer:${LAYERDIR}/dynamic-layers/freescale-layer/recipes*/*/*.bbappend \
    intel:${LAYERDIR}/dynamic-layers/intel/recipes*/*/*.bb \
    intel:${LAYERDIR}/dynamic-layers/intel/recipes*/*/*.bbappend \
    raspberrypi:${LAYERDIR}/dynamic-layers/raspberrypi/recipes*/*/*.bb \
    raspberrypi:${LAYERDIR}/dynamic-layers/raspberrypi/recipes*/*/*.bbappend \
    tegra:${LAYERDIR}/dynamic-layers/tegra/recipes*/*/*.bb \
    tegra:${LAYERDIR}/dynamic-layers/tegra/recipes*/*/*.bbappend \
"

BBMASK += "${@ 'qtspeech_git.bbappend' if bb.utils.vercmp_string(d.getVar('QT_VERSION'), '6.4') < 0 else '' }"
BBMASK += "${@ 'qtvncserver_git.bbappend' if bb.utils.vercmp_string(d.getVar('QT_VERSION'), '6.5') < 0 else '' }"
```
